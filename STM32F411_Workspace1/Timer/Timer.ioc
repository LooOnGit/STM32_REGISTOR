# file: Timer.ioc
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Mcu.Family=STM32F4
Mcu.Name=STM32F411V(C-E)Tx
Mcu.Package=LQFP100
NVIC.PriorityGroup=NVIC_PRIORITYGROUP_4
PA13.Mode=Serial_Wire
PA13.Signal=SYS_JTMS-SWDIO
PA14.Mode=Serial_Wire
PA14.Signal=SYS_JTCK-SWCLK
PH0\ -\ OSC_IN.Mode=HSE-External-Oscillator
PH0\ -\ OSC_IN.Signal=RCC_OSC_IN
PH1\ -\ OSC_OUT.Mode=HSE-External-Oscillator
PH1\ -\ OSC_OUT.Signal=RCC_OSC_OUT
ProjectManager.HeapSize=0x200
ProjectManager.StackSize=0x400
ProjectManager.TargetToolchain=STM32CubeIDE
RCC.AHBFreq_Value=16000000
RCC.APB1Freq_Value=16000000
RCC.APB2Freq_Value=16000000
RCC.CortexFreq_Value=16000000
RCC.HSE_VALUE=25000000
RCC.HSI_VALUE=16000000
RCC.LSE_VALUE=32768
RCC.SYSCLKFreq_VALUE=16000000
RCC.VCOOutputFreq_Value=192000000
board=custom

// file: Core/Src/main.c
/* USER CODE BEGIN Header */
/**
  ******************************************************************************
  * @file           : main.c
  * @brief          : Main program body
  ******************************************************************************
  * @attention
  *
  * Copyright (c) 2025 STMicroelectronics.
  * All rights reserved.
  *
  * This software is licensed under terms that can be found in the LICENSE file
  * in the root directory of this software component.
  * If no LICENSE file comes with this software, it is provided AS-IS.
  *
  ******************************************************************************
  */
/* USER CODE END Header */
#include "main.h"

/* USER CODE BEGIN PD */
#define GPIOA_BASE_ARR 0x40020000
#define GPIOD_BASE_ARR 0x40020C00

typedef enum
{
	GREEN_LED = 12,
	ORANGE_LED,
	RED_LED,
	BLUE_LED
}led_num_t;

typedef enum
{
	LED_OFF,
	LED_ON
}led_state_t;

/* USER CODE END PD */

void SystemClock_Config(void);
static void MX_GPIO_Init(void);

/* USER CODE BEGIN 0 */
void leds_init(){
	//set PD12, PD13, PD14, PD15 in output push-pull
	__HAL_RCC_GPIOD_CLK_ENABLE();

	uint32_t* GPIOD_MODER = (uint32_t*)(GPIOD_BASE_ARR + 0x00);
	*GPIOD_MODER |= (0b01 << 24);//set PD12 in OUTPUT
	*GPIOD_MODER |= (0b01 << 26);//set PD13 in OUTPUT
	*GPIOD_MODER |= (0b01 << 28);//set PD14 in OUTPUT
	*GPIOD_MODER |= (0b01 << 30);//set PD15 in OUTPUT

	uint32_t* GPIOD_OTYPER = (uint32_t*)(GPIOD_BASE_ARR + 0x04);
	*GPIOD_OTYPER &= ~(0b1111 << 12);//set PD12, PD13, PD14, PD15
}

void led_controls(led_num_t led, led_state_t state)
{
	uint32_t* GPIOD_ODR = (uint32_t*)(GPIOD_BASE_ARR + 0x14);
	if(state == LED_ON)
		*GPIOD_ODR |= 1 << led;
	else
		*GPIOD_ODR &= ~(1<<led);
}

void tim1_init()
{
	//set 1 sec for time//
	//rcc --> 16Mhz --> psc (16000) --> 1000Hz
	//ARR = 1000

	__HAL_RCC_TIM1_CLK_ENABLE();
	uint16_t* DIER = (uint16_t*)(0x4001000c);
	uint16_t* CR1 = (uint16_t*)(0x40010000);
	uint16_t* ARR = (uint16_t*)(0x4001002c);
	uint16_t* PSC = (uint16_t*)(0x40010028);

	*ARR = 1000;
//	*PSC = 16000 - 1;//sec
	*PSC = 16 - 1;//msec

	*DIER |= 1<<0; //enable interrupt
	*CR1 |= 1 << 0;

	uint32_t* ISER0 = (uint32_t*)(0xe000e100);//NVIC
	*ISER0 |= (1<<25);//enable interrupt time1
}

uint32_t tim1_cnt = 0;
void TIM1_UP_TIM10_IRQHandler()
{
	uint16_t* SR = (uint16_t*)(0x40010010);
	*SR &= ~(1 << 0);			//clean UIF flag
	tim1_cnt++;
}

void tim1_delay_1sec()
{
	uint16_t* SR = (uint16_t*)(0x40010010);
	while(((*SR >> 0)&1) != 1);//wait UIF flag is set to 1
	*SR &= ~(1 << 0);			//clean UIF flag
}

void tim1_delay(uint32_t msec)
{
	uint32_t currrent_cnt = tim1_cnt;
	while((uint32_t)(tim1_cnt - currrent_cnt) <  msec);
}
/* USER CODE END 0 */

int main(void)
{

  /* MCU Configuration--------------------------------------------------------*/

  /* Reset of all peripherals, Initializes the Flash interface and the Systick. */
  HAL_Init();

  /* Configure the system clock */
  SystemClock_Config();

  /* Initialize all configured peripherals */
  MX_GPIO_Init();
  /* USER CODE BEGIN 2 */
  leds_init();
  tim1_init();
  /* USER CODE END 2 */

  /* Infinite loop */
  while (1)
  {

    /* USER CODE BEGIN 3 */
	  led_controls(BLUE_LED, LED_ON);
	  tim1_delay(1000);
	  led_controls(BLUE_LED, LED_OFF);
	  tim1_delay(1000);
  }
  /* USER CODE END 3 */
}

void SystemClock_Config(void)
{
  RCC_OscInitTypeDef RCC_OscInitStruct = {0};
  RCC_ClkInitTypeDef RCC_ClkInitStruct = {0};

  /** Configure the main internal regulator output voltage
  */
  __HAL_RCC_PWR_CLK_ENABLE();
  __HAL_PWR_VOLTAGESCALING_CONFIG(PWR_REGULATOR_VOLTAGE_SCALE1);

  /** Initializes the RCC Oscillators according to the specified parameters
  * in the RCC_OscInitTypeDef structure.
  */
  RCC_OscInitStruct.OscillatorType = RCC_OSCILLATORTYPE_HSI;
  RCC_OscInitStruct.HSIState = RCC_HSI_ON;
  RCC_OscInitStruct.HSICalibrationValue = RCC_HSICALIBRATION_DEFAULT;
  RCC_OscInitStruct.PLL.PLLState = RCC_PLL_NONE;
  if (HAL_RCC_OscConfig(&RCC_OscInitStruct) != HAL_OK)
  {
    Error_Handler();
  }

  /** Initializes the CPU, AHB and APB buses clocks
  */
  RCC_ClkInitStruct.ClockType = RCC_CLOCKTYPE_HCLK|RCC_CLOCKTYPE_SYSCLK
                              |RCC_CLOCKTYPE_PCLK1|RCC_CLOCKTYPE_PCLK2;
  RCC_ClkInitStruct.SYSCLKSource = RCC_SYSCLKSOURCE_HSI;
  RCC_ClkInitStruct.AHBCLKDivider = RCC_SYSCLK_DIV1;
  RCC_ClkInitStruct.APB1CLKDivider = RCC_HCLK_DIV1;
  RCC_ClkInitStruct.APB2CLKDivider = RCC_HCLK_DIV1;

  if (HAL_RCC_ClockConfig(&RCC_ClkInitStruct, FLASH_LATENCY_0) != HAL_OK)
  {
    Error_Handler();
  }
}

static void MX_GPIO_Init(void)
{

  /* GPIO Ports Clock Enable */
  __HAL_RCC_GPIOH_CLK_ENABLE();
  __HAL_RCC_GPIOA_CLK_ENABLE();

}

void Error_Handler(void)
{
  __disable_irq();
  while (1)
  {
  }
}
