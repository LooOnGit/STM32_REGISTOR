# file: FW2_App1.ioc
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Mcu.Family=STM32F4
Mcu.Name=STM32F411V(C-E)Tx
Mcu.Package=LQFP100
NVIC.PriorityGroup=NVIC_PRIORITYGROUP_4
PA13.Mode=Serial_Wire
PA13.Signal=SYS_JTMS-SWDIO
PA14.Mode=Serial_Wire
PA14.Signal=SYS_JTCK-SWCLK
PD14.Signal=GPIO_Output
ProjectManager.HeapSize=0x200
ProjectManager.StackSize=0x400
ProjectManager.TargetToolchain=STM32CubeIDE
RCC.AHBFreq_Value=16000000
RCC.APB1Freq_Value=16000000
RCC.APB2Freq_Value=16000000
RCC.CortexFreq_Value=16000000
RCC.HSE_VALUE=25000000
RCC.HSI_VALUE=16000000
RCC.LSE_VALUE=32768
RCC.SYSCLKFreq_VALUE=16000000
RCC.VCOOutputFreq_Value=192000000
board=custom

// file: Core/Src/main.c
/* USER CODE BEGIN Header */
/**
  ******************************************************************************
  * @file           : main.c
  * @brief          : Main program body
  ******************************************************************************
  * @attention
  *
  * Copyright (c) 2025 STMicroelectronics.
  * All rights reserved.
  *
  * This software is licensed under terms that can be found in the LICENSE file
  * in the root directory of this software component.
  * If no LICENSE file comes with this software, it is provided AS-IS.
  *
  ******************************************************************************
  */
/* USER CODE END Header */
#include "main.h"

/* USER CODE BEGIN Includes */
#include <stdio.h>
/* USER CODE END Includes */

void SystemClock_Config(void);
static void MX_GPIO_Init(void);

/* USER CODE BEGIN 0 */

void spi_active_slave()
{
	uint32_t* GPIOE_ODR = (uint32_t*)(0x40021014);
	//set LOW for PE3
	*GPIOE_ODR &= ~(1<<3);
}

void spi_inactive_slave()
{
	uint32_t* GPIOE_ODR = (uint32_t*)(0x40021014);
	//set HIGH for PE3
	*GPIOE_ODR |= (1<<3);
}

#define WHO_AM_I_REG  	0x0f
#define CTRL1_REG 		0x20
#define OUT_X_L 		0x28
#define OUT_X_H 		0x29
#define OUT_Y_L 		0x2A
#define OUT_Y_H 		0x2B
#define OUT_Z_L 		0x2C
#define OUT_Z_H 		0x2D

#define I3G4250D_FULLSCALE_245       ((uint8_t)0x00)
#define I3G4250D_FULLSCALE_500       ((uint8_t)0x10)
#define I3G4250D_FULLSCALE_2000      ((uint8_t)0x20)
#define I3G4250D_FULLSCALE_SELECTION ((uint8_t)0x30)

#define I3G4250D_BLE_LSB                     ((uint8_t)0x00)
#define I3G4250D_BLE_MSB                     ((uint8_t)0x40)

uint16_t dataX = 0;
uint16_t dataY = 0;
uint16_t dataZ = 0;

void spi_init()
{
	//set PA5(alternate funxtion - SPI1_SCK), PA6(alternate function - SPI1_MISO), PA7(alternate function - MOSI)
	__HAL_RCC_GPIOA_CLK_ENABLE();
	uint32_t* GPIOA_MODER = (uint32_t*)(0x40020000);
	uint32_t* GPIOA_AFRL = (uint32_t*)(0x40020020);
	*GPIOA_MODER |= (0b10 << 10) | (0b10 << 12) | (0b10) << 14;
	*GPIOA_AFRL |= (5<<20)|(5<<24)|(5<<28);

	//set PE3 in OUTPUT mode
	__HAL_RCC_GPIOE_CLK_ENABLE();
	uint32_t* GPIOE_MODER = (uint32_t*)(0x40021000);
	*GPIOE_MODER |= (0b01<<6);

	//init spi1 in master
	__HAL_RCC_SPI1_CLK_ENABLE(); //--enable 16Mhz clock spi
	uint32_t* CR1 = (uint32_t*)(0x40013000);
	*CR1 |= (0b100 << 3);// set baudrate 500Khz = (16Mhz / 32);
	*CR1 |= 1 << 2;		// select master mode for spi1
	*CR1 |= (1<<8)|(1<<9); //SS pin controlled by GPIO without SPI1
	*CR1 |= 1<<6;		//enable SPI1
	//MODE3 CPOL, CPHA
	*CR1 |= 1<<1;
	*CR1 |= 1<<0;
}

char spi_read_data(char reg)
{
	uint32_t* DR = (uint32_t*)(0x4001300c);
	uint32_t* SR = (uint32_t*)(0x40013008);
	//active slave - set PE3 to LOW
	spi_active_slave();
	//send reg to slave - WRITE reg value to DR of SPI1
	while(((*SR >> 1) & 1)!= 1); //wait TX empty to write data DR
	*DR = reg | (1 << 7); //bit RW in sensor monitor
	while(((*SR >> 1) & 1) == 1); //wait data be transfered to Tx buffer
	while(((*SR >> 0) & 1) != 1); //wait RXNE not empty (has recv data) to read data
	while(((*SR >> 7) & 1) == 1); //wait not busy

	//clear spam data - read data from DR
	uint8_t temp = *DR;

	//send clock for slave to slave send data to master. write dummy data(0x00 or 0xFF) to DR
	while(((*SR >> 1) & 1)!= 1); //wait TX empty to write data DR
	*DR = 0xFF; //write dummy data
	while(((*SR >> 1) & 1) == 1); //wait data be transfered to Tx buffer
	while(((*SR >> 0) & 1) != 1); //wait RXNE not empty (has recv data) to read data
	while(((*SR >> 7) & 1) == 1); //wait not busy

	//read data from DR
	temp = *DR;

	//inactive slave - set PE3 to HIGH
	spi_inactive_slave();
	return temp;
}

void spi_write_data(char reg, char data)
{
	uint32_t* DR = (uint32_t*)(0x4001300c);
	uint32_t* SR = (uint32_t*)(0x40013008);
	//active slave - set PE3 to LOW
	spi_active_slave();
	//send reg to slave - WRITE reg value to DR of SPI1
	while(((*SR >> 1) & 1)!= 1); //wait TX empty to write data DR
	*DR = reg;
	while(((*SR >> 1) & 1) == 1); //wait data be transfered to Tx buffer
	while(((*SR >> 0) & 1) != 1); //wait RXNE not empty (has recv data) to read data
	while(((*SR >> 7) & 1) == 1); //wait not busy

	//clear spam data - read data from DR
	uint8_t temp = *DR;

	//send clock for slave to slave send data to master. write dummy data(0x00 or 0xFF) to DR
	while(((*SR >> 1) & 1)!= 1); //wait TX empty to write data DR
	*DR = data; //write dummy data
	while(((*SR >> 1) & 1) == 1); //wait data be transfered to Tx buffer
	while(((*SR >> 0) & 1) != 1); //wait RXNE not empty (has recv data) to read data
	while(((*SR >> 7) & 1) == 1); //wait not busy

	//read data from DR
	temp = *DR;

	//inactive slave - set PE3 to HIGH
	spi_inactive_slave();
	return temp;
}

int16_t read_axis(uint8_t reg_l, uint8_t reg_h) {
    uint8_t l = spi_read_data(reg_l);
    uint8_t h = spi_read_data(reg_h);
    return (int16_t)((h << 8) | l);
}

//void I3G4250D_ReadXYZAngRate(float *pfData)
//{
//  uint8_t tmpbuffer[6] = {0};
//  int16_t RawData[3] = {0};
//  uint8_t tmpreg = 0;
//  float sensitivity = 0;
//  int i = 0;
//
//  tmpbuffer GYRO_IO_Read(&tmpreg, I3G4250D_CTRL_REG4_ADDR, 1);
//
//  GYRO_IO_Read(tmpbuffer, I3G4250D_OUT_X_L_ADDR, 6);
//
//  /* check in the control register 4 the data alignment (Big Endian or Little Endian)*/
//  if (!(tmpreg & I3G4250D_BLE_MSB))
//  {
//    for (i = 0; i < 3; i++)
//    {
//      RawData[i] = (int16_t)(((uint16_t)tmpbuffer[2 * i + 1] << 8) + tmpbuffer[2 * i]);
//    }
//  }
//  else
//  {
//    for (i = 0; i < 3; i++)
//    {
//      RawData[i] = (int16_t)(((uint16_t)tmpbuffer[2 * i] << 8) + tmpbuffer[2 * i + 1]);
//    }
//  }
//
//  /* Switch the sensitivity value set in the CRTL4 */
//  switch (tmpreg & I3G4250D_FULLSCALE_SELECTION)
//  {
//    case I3G4250D_FULLSCALE_245:
//      sensitivity = I3G4250D_SENSITIVITY_245DPS;
//      break;
//
//    case I3G4250D_FULLSCALE_500:
//      sensitivity = I3G4250D_SENSITIVITY_500DPS;
//      break;
//
//    case I3G4250D_FULLSCALE_2000:
//      sensitivity = I3G4250D_SENSITIVITY_2000DPS;
//      break;
//  }
//  /* Multiplied by sensitivity */
//  for (i = 0; i < 3; i++)
//  {
//    pfData[i] = (float)(RawData[i] * sensitivity);
//  }
//}

/* USER CODE END 0 */

int main(void)
{

  /* MCU Configuration--------------------------------------------------------*/

  /* Reset of all peripherals, Initializes the Flash interface and the Systick. */
  HAL_Init();

  /* Configure the system clock */
  SystemClock_Config();

  /* Initialize all configured peripherals */
  MX_GPIO_Init();
  /* USER CODE BEGIN 2 */
  spi_init();
  uint8_t gyro_id = spi_read_data(WHO_AM_I_REG);
  gyro_id = spi_read_data(CTRL1_REG);
  spi_write_data(CTRL1_REG, 0b00001111);
  gyro_id = spi_read_data(CTRL1_REG);
  /* USER CODE END 2 */

  /* Infinite loop */
  while (1)
  {

  }
}

void SystemClock_Config(void)
{
  RCC_OscInitTypeDef RCC_OscInitStruct = {0};
  RCC_ClkInitTypeDef RCC_ClkInitStruct = {0};

  /** Configure the main internal regulator output voltage
  */
  __HAL_RCC_PWR_CLK_ENABLE();
  __HAL_PWR_VOLTAGESCALING_CONFIG(PWR_REGULATOR_VOLTAGE_SCALE1);

  /** Initializes the RCC Oscillators according to the specified parameters
  * in the RCC_OscInitTypeDef structure.
  */
  RCC_OscInitStruct.OscillatorType = RCC_OSCILLATORTYPE_HSI;
  RCC_OscInitStruct.HSIState = RCC_HSI_ON;
  RCC_OscInitStruct.HSICalibrationValue = RCC_HSICALIBRATION_DEFAULT;
  RCC_OscInitStruct.PLL.PLLState = RCC_PLL_NONE;
  if (HAL_RCC_OscConfig(&RCC_OscInitStruct) != HAL_OK)
  {
    Error_Handler();
  }

  /** Initializes the CPU, AHB and APB buses clocks
  */
  RCC_ClkInitStruct.ClockType = RCC_CLOCKTYPE_HCLK|RCC_CLOCKTYPE_SYSCLK
                              |RCC_CLOCKTYPE_PCLK1|RCC_CLOCKTYPE_PCLK2;
  RCC_ClkInitStruct.SYSCLKSource = RCC_SYSCLKSOURCE_HSI;
  RCC_ClkInitStruct.AHBCLKDivider = RCC_SYSCLK_DIV1;
  RCC_ClkInitStruct.APB1CLKDivider = RCC_HCLK_DIV1;
  RCC_ClkInitStruct.APB2CLKDivider = RCC_HCLK_DIV1;

  if (HAL_RCC_ClockConfig(&RCC_ClkInitStruct, FLASH_LATENCY_0) != HAL_OK)
  {
    Error_Handler();
  }
}

static void MX_GPIO_Init(void)
{
  GPIO_InitTypeDef GPIO_InitStruct = {0};

  /* GPIO Ports Clock Enable */
  __HAL_RCC_GPIOD_CLK_ENABLE();
  __HAL_RCC_GPIOA_CLK_ENABLE();

  /*Configure GPIO pin Output Level */
  HAL_GPIO_WritePin(GPIOD, GPIO_PIN_14, GPIO_PIN_RESET);

  /*Configure GPIO pin : PD14 */
  GPIO_InitStruct.Pin = GPIO_PIN_14;
  GPIO_InitStruct.Mode = GPIO_MODE_OUTPUT_PP;
  GPIO_InitStruct.Pull = GPIO_NOPULL;
  GPIO_InitStruct.Speed = GPIO_SPEED_FREQ_LOW;
  HAL_GPIO_Init(GPIOD, &GPIO_InitStruct);

}

void Error_Handler(void)
{
  __disable_irq();
  while (1)
  {
  }
}
